## config/boards/shields/solderless_v2/Kconfig.defconfig
```kconfig
# Copyright (c) 2020 The ZMK Contributors
# SPDX-License-Identifier: MIT

if SHIELD_SOLDERLESS_V2_RIGHT

config ZMK_KEYBOARD_NAME
	default "Solderless V2"

config ZMK_SPLIT_ROLE_CENTRAL
	default y

endif

if SHIELD_SOLDERLESS_V2_LEFT || SHIELD_SOLDERLESS_V2_RIGHT

config ZMK_SPLIT
	default y

endif
```

## config/boards/shields/solderless_v2/Kconfig.shield
```kconfig
# Copyright (c) 2020 The ZMK Contributors
# SPDX-License-Identifier: MIT

config SHIELD_SOLDERLESS_V2_LEFT
	def_bool $(shields_list_contains,solderless_v2_left)

config SHIELD_SOLDERLESS_V2_RIGHT
	def_bool $(shields_list_contains,solderless_v2_right)
```
